## conf/layer.conf
```bitbake
# We have a conf and classes directory, add to BBPATH
BBPATH .= ":${LAYERDIR}"

# We have recipes-* directories, add to BBFILES
BBFILES += "${LAYERDIR}/recipes-*/*/*.bb \
            ${LAYERDIR}/recipes-*/*/*.bbappend"

BBFILE_COLLECTIONS += "meta-amateurradio"
BBFILE_PATTERN_meta-amateurradio = "^${LAYERDIR}/"
BBFILE_PRIORITY_meta-amateurradio = "6"

LAYERDEPENDS_meta-amateurradio = "core"
LAYERDEPENDS_meta-amateurradio += "openembedded-layer"

LAYERSERIES_COMPAT_meta-amateurradio = "kirkstone"

BBFILES_DYNAMIC += " \
  qt5-layer:${LAYERDIR}/dynamic-layers/qt5-layer/*/*/*.bb \
  qt5-layer:${LAYERDIR}/dynamic-layers/qt5-layer/*/*/*.bbappend \
"
```
